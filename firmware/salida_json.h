#ifndef SALIDA_JSON_H
#define SALIDA_JSON_H

// Emite una linea JSON por inferencia segun docs/CONTRATO.md. Requiere que el sketch ya haya
// incluido la libreria de Edge Impulse (ei_impulse_result_t, ei_classifier_inferencing_categories).
#include <Arduino.h>
#include <string.h>
#include "xiao_pins.h"

// Las etiquetas del modelo salen tal cual en "probs" (todas, sin lista fija). Para cumplir el
// contrato (docs/CONTRATO.md) deben ser minusculas ASCII [a-z0-9_] de hasta 24 caracteres. Edge
// Impulse permite otras: nombra las clases asi desde el principio (el nombre de la carpeta o del ZIP
// de cada clase es la etiqueta). El contrato admite de 2 a 16 clases.

// Probabilidad de la clase `nombre`, buscada por etiqueta y nunca por posicion.
static inline float sj_prob(const ei_impulse_result_t &r, const char *nombre) {
    for (size_t i = 0; i < EI_CLASSIFIER_LABEL_COUNT; i++) {
        if (strcmp(r.classification[i].label, nombre) == 0) return r.classification[i].value;
    }
    return 0.0f;
}

// Clase ganadora (entre las etiquetas del modelo) y su confianza.
static inline void sj_ganadora(const ei_impulse_result_t &r, const char **clase, float *conf) {
    size_t mejor = 0;
    for (size_t i = 1; i < EI_CLASSIFIER_LABEL_COUNT; i++) {
        if (r.classification[i].value > r.classification[mejor].value) mejor = i;
    }
    *clase = ei_classifier_inferencing_categories[mejor];
    *conf = r.classification[mejor].value;
}

// true si `clase` aparece en la lista separada por comas `lista` ("tijera,metal"). Compara la
// etiqueta completa, sin espacios alrededor de las comas.
static inline bool sj_en_lista(const char *clase, const char *lista) {
    if (clase == nullptr || lista == nullptr || clase[0] == '\0') return false;
    size_t n = strlen(clase);
    const char *p = lista;
    while (*p != '\0') {
        const char *coma = strchr(p, ',');
        size_t largo = coma ? (size_t)(coma - p) : strlen(p);
        if (largo == n && strncmp(p, clase, n) == 0) return true;
        if (!coma) break;
        p = coma + 1;
    }
    return false;
}

static inline bool sj_en_array(const char *clase, const char *const *lista, size_t n) {
    if (clase == nullptr || lista == nullptr) return false;
    for (size_t i = 0; i < n; i++) {
        if (lista[i] != nullptr && strcmp(clase, lista[i]) == 0) return true;
    }
    return false;
}

static inline void sj_poner_led(bool encendido) {
    static bool iniciado = false;
    if (!iniciado) {
        pinMode(LED_GPIO, OUTPUT);
        iniciado = true;
    }
#if LED_ACTIVO_BAJO
    digitalWrite(LED_GPIO, encendido ? LOW : HIGH);
#else
    digitalWrite(LED_GPIO, encendido ? HIGH : LOW);
#endif
}

// Enciende el LED si la clase ganadora esta en `clases_led` (lista separada por comas, p. ej.
// "tijera,metal"; una sola clase tambien vale) y conf >= umbral. Devuelve el estado logico.
static inline bool actualizar_led(const char *clase, float conf, const char *clases_led, float umbral) {
    bool encendido = sj_en_lista(clase, clases_led) && conf >= umbral;
    sj_poner_led(encendido);
    return encendido;
}

// Variante con un array de clases.
static inline bool actualizar_led(const char *clase, float conf, const char *const *clases_led, size_t n,
                                  float umbral) {
    bool encendido = sj_en_array(clase, clases_led, n) && conf >= umbral;
    sj_poner_led(encendido);
    return encendido;
}

static inline void emitir_json(const ei_impulse_result_t &r, uint32_t n, float umbral, bool led) {
    const char *clase;
    float conf;
    sj_ganadora(r, &clase, &conf);
    Serial.printf("{\"v\":1,\"fuente\":\"xiao\",\"n\":%lu,\"t_ms\":%lu,\"clase\":\"%s\",\"confianza\":%.4f,\"probs\":{",
                  (unsigned long)n, (unsigned long)millis(), clase, conf);
    for (size_t i = 0; i < EI_CLASSIFIER_LABEL_COUNT; i++) {
        if (i > 0) Serial.print(',');
        Serial.print('"');
        Serial.print(ei_classifier_inferencing_categories[i]);
        Serial.print("\":");
        Serial.print(r.classification[i].value, 4);
    }
    Serial.printf("},\"lat_ms\":{\"dsp\":%d,\"inf\":%d},\"led\":%s,\"umbral\":%.4f}\n",
                  (int)r.timing.dsp, (int)r.timing.classification, led ? "true" : "false", umbral);
}

#endif
